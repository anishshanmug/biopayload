#ifndef BIOPAYLOAD_LINEAR_ACTUATOR_H
#define BIOPAYLOAD_LINEAR_ACTUATOR_H

// ESP32-friendly stepper-motor driver for the TMC2208 + Haydon Kerk Size 8
// linear actuator. Replaces the AVR-only register-poking version of this
// header that lived here previously.
//
// *** Step pulses are now generated by an esp_timer periodic callback ***
//
// The callback runs in the ESP-IDF timer task (FreeRTOS priority 22), which
// is higher than Arduino's loop() task (~priority 1). Steps therefore fire on
// schedule even when loop() is blocked by a long synchronous operation such as
// SPEC_READ (~250 ms integration). The previous micros()-polled approach
// starved the motor of pulses for the full duration of any blocking call,
// causing visible jitter when streaming spectral reads.
//
// Public API is unchanged. update() is still called every loop() but is now
// only a state-machine handler (limit-switch polling, timeout, completion
// cleanup); it no longer generates step pulses.
//
// Modes (visible via status()):
//   IDLE     - no motion in progress
//   MOVING   - executing startMoveSteps() / startContinuous()
//   HOMING   - executing startHome(); two-phase sequence:
//                Phase 1: reverse continuously until limit switch closes.
//                Phase 2: if postHomeSteps_ > 0, continue reverse for that
//                         many more steps (post-home travel to the true zero
//                         reference, e.g. flush with back wall). Status stays
//                         HOMING throughout so the dispatcher sees one async op.
//              On completion pos_ = 0. On timeout (phase 1 only), homeFailed()
//              goes true and the caller emits `ERR HOME_TIMEOUT`.
//
// Position semantics: pos_ is a signed step counter relative to the most
// recent successful home. Forward steps increment it, reverse steps decrement.
// homed() returns false until at least one home has succeeded.
//
// Driver enable convention: TMC2208's EN pin is active-LOW. Constructor
// accepts -1 for `enPin` if EN is hard-tied to GND on the board.

#include <Arduino.h>
#include "esp_timer.h"

#include "components/limit_switch.h"

namespace components {

class LinearActuator {
 public:
  enum class Status : uint8_t { IDLE = 0, MOVING = 1, HOMING = 2 };

  static constexpr int           DEFAULT_PIN_STEP         = 4;
  static constexpr int           DEFAULT_PIN_DIR          = 2;
  static constexpr int           DEFAULT_PIN_EN           = 3;
  static constexpr unsigned long DEFAULT_STEP_INTERVAL_US = 120;
  static constexpr unsigned long DEFAULT_HOME_TIMEOUT_MS  = 90000;  // 90 s for full-travel homing

  LinearActuator(int stepPin = DEFAULT_PIN_STEP,
                 int dirPin  = DEFAULT_PIN_DIR,
                 int enPin   = DEFAULT_PIN_EN)
      : pinStep_(stepPin), pinDir_(dirPin), pinEn_(enPin) {}

  bool begin() {
    pinMode(pinStep_, OUTPUT);
    pinMode(pinDir_, OUTPUT);
    if (pinEn_ >= 0) pinMode(pinEn_, OUTPUT);
    digitalWrite(pinStep_, LOW);
    setDirection_(false);
    setEnabled_(false);
    forward_ = true;

    // Create the step timer once; it is started/stopped per motion command.
    esp_timer_create_args_t args{};
    args.callback        = &LinearActuator::stepCb_;
    args.arg             = this;
    args.dispatch_method = ESP_TIMER_TASK;  // high-priority FreeRTOS task
    args.name            = "stepper";
    esp_timer_create(&args, &timer_);

    return true;
  }

  bool present() const { return true; }

  void enable()        { setEnabled_(true);  }
  void disable()       { setEnabled_(false); }
  bool enabled() const { return enabled_;    }

  void setDirection(bool forward) { setDirection_(forward); }

  // Bounded N-step motion. Positive = forward, negative = reverse.
  void startMoveSteps(long steps) {
    if (steps == 0) {
      stopAll_();
      return;
    }
    stopAll_();
    if (!enabled_) enable();
    setDirection_(steps > 0);
    timerContinuous_ = false;
    timerRemaining_  = (steps > 0) ? static_cast<unsigned long>(steps)
                                   : static_cast<unsigned long>(-steps);
    timerActive_     = true;
    status_          = Status::MOVING;
    esp_timer_start_periodic(timer_, stepIntervalUs_);
  }

  void startContinuous(bool forward) {
    stopAll_();
    if (!enabled_) enable();
    setDirection_(forward);
    timerContinuous_ = true;
    timerRemaining_  = 0;
    timerActive_     = true;
    status_          = Status::MOVING;
    esp_timer_start_periodic(timer_, stepIntervalUs_);
  }

  // Reverse continuously until limit switch closes; zero position on success.
  // On timeout, homeFailed_ goes true — caller emits `ERR HOME_TIMEOUT`.
  void startHome(LimitSwitch& sw, unsigned long timeoutMs = DEFAULT_HOME_TIMEOUT_MS) {
    stopAll_();
    if (!enabled_) enable();
    setDirection_(false);
    timerContinuous_   = true;
    timerRemaining_    = 0;
    timerActive_       = true;
    homingSwitch_      = &sw;
    homingDeadlineMs_  = millis() + timeoutMs;
    homeFailed_        = false;
    postHomeTraveling_ = false;
    status_            = Status::HOMING;
    esp_timer_start_periodic(timer_, stepIntervalUs_);
  }

  // Immediate stop — halts the hardware timer right away.
  void stop()  { stopAll_(); }
  void abort() { stopAll_(); }

  // State-machine tick. Called every loop() but no longer generates step
  // pulses — that is handled by the hardware timer callback.
  void update() {
    if (status_ == Status::IDLE) return;

    // Bounded move: callback cleared timerActive_ when step count reached 0.
    if (status_ == Status::MOVING && !timerContinuous_ && !timerActive_) {
      stopAll_();
      return;
    }

    if (status_ == Status::HOMING) {
      if (!postHomeTraveling_) {
        // Phase 1: poll limit switch.
        if (homingSwitch_ && homingSwitch_->closed()) {
          homingSwitch_ = nullptr;
          if (postHomeSteps_ > 0) {
            // Switch tripped; transition to phase 2 bounded reverse.
            // Stop timer, reconfigure for bounded move, restart.
            esp_timer_stop(timer_);
            pos_               = static_cast<long>(postHomeSteps_);
            timerContinuous_   = false;
            timerRemaining_    = postHomeSteps_;
            postHomeTraveling_ = true;
            timerActive_       = true;
            esp_timer_start_periodic(timer_, stepIntervalUs_);
          } else {
            stopAll_();
            pos_   = 0;
            homed_ = true;
          }
        } else if (static_cast<long>(millis() - homingDeadlineMs_) >= 0) {
          stopAll_();
          homeFailed_ = true;
        }
      } else if (!timerActive_) {
        // Phase 2 complete.
        stopAll_();
        pos_   = 0;
        homed_ = true;
      }
    }
  }

  Status        status()        const { return status_; }
  bool          moving()        const { return status_ != Status::IDLE; }
  long          position()      const { return pos_; }
  bool          homed()         const { return homed_; }
  bool          homeFailed()    const { return homeFailed_; }
  void          clearHomeFailed()     { homeFailed_ = false; }
  // Set the step interval. If the motor is currently running the hardware
  // timer is restarted immediately so the speed change takes effect at once
  // (there is a sub-microsecond gap during the stop/start which is negligible).
  void setStepIntervalUs(unsigned long us) {
    stepIntervalUs_ = us;
    if (timerActive_ && timer_) {
      esp_timer_stop(timer_);
      esp_timer_start_periodic(timer_, stepIntervalUs_);
    }
  }
  unsigned long stepIntervalUs() const { return stepIntervalUs_; }

  // Extra reverse steps after switch closes before zeroing pos_.
  // Set to 9333 so the back wall (9333 steps past the switch) becomes pos 0.
  void          setPostHomeSteps(unsigned long steps) { postHomeSteps_ = steps; }
  unsigned long postHomeSteps()  const                { return postHomeSteps_; }

 private:
  // ---------------------------------------------------------------------------
  // Timer callback — runs in esp_timer task (FreeRTOS priority 22).
  // Fires every stepIntervalUs_ microseconds independently of loop().
  // ---------------------------------------------------------------------------
  static void stepCb_(void* arg) {
    auto* self = static_cast<LinearActuator*>(arg);
    if (!self->timerActive_) return;

    // Step pulse. digitalWrite is safe in timer-task context.
    digitalWrite(self->pinStep_, HIGH);
    delayMicroseconds(1);
    digitalWrite(self->pinStep_, LOW);

    // Update position. homing phase-1 drift is zeroed on successful home.
    self->pos_ += self->forward_ ? 1 : -1;

    // Bounded move: flag completion; update() will call stopAll_() shortly.
    if (!self->timerContinuous_) {
      if (--self->timerRemaining_ == 0) {
        self->timerActive_ = false;
      }
    }
  }

  // ---------------------------------------------------------------------------
  // Helpers
  // ---------------------------------------------------------------------------

  // Stop timer, disable driver, reset all motion state.
  void stopAll_() {
    // esp_timer_stop is safe even when the timer is not currently active.
    if (timer_) esp_timer_stop(timer_);
    timerActive_       = false;
    timerContinuous_   = false;
    timerRemaining_    = 0;
    homingSwitch_      = nullptr;
    postHomeTraveling_ = false;
    status_            = Status::IDLE;
    setEnabled_(false);
  }

  void setDirection_(bool forward) {
    forward_ = forward;
    digitalWrite(pinDir_, forward ? HIGH : LOW);
  }

  void setEnabled_(bool en) {
    if (pinEn_ >= 0) digitalWrite(pinEn_, en ? LOW : HIGH);  // active-LOW
    enabled_ = en;
  }

  // ---------------------------------------------------------------------------
  // Pin config
  // ---------------------------------------------------------------------------
  int pinStep_;
  int pinDir_;
  int pinEn_;

  // ---------------------------------------------------------------------------
  // Motion state (main-loop side)
  // ---------------------------------------------------------------------------
  Status status_     = Status::IDLE;
  bool   enabled_    = false;
  bool   forward_    = true;
  bool   homed_      = false;
  bool   homeFailed_ = false;

  LimitSwitch*  homingSwitch_      = nullptr;
  unsigned long homingDeadlineMs_  = 0;
  bool          postHomeTraveling_ = false;
  unsigned long postHomeSteps_     = 0;

  // ---------------------------------------------------------------------------
  // Timer-shared state
  // volatile: written by the timer task, read/written by loop() task.
  // On ESP32 (Xtensa LX7), 32-bit aligned r/w is a single instruction and
  // therefore atomic, making volatile sufficient for these scalar fields.
  // ---------------------------------------------------------------------------
  volatile bool          timerActive_     = false;
  volatile bool          timerContinuous_ = false;
  volatile unsigned long timerRemaining_  = 0;
  volatile long          pos_             = 0;

  unsigned long      stepIntervalUs_ = DEFAULT_STEP_INTERVAL_US;
  esp_timer_handle_t timer_          = nullptr;
};

}  // namespace components

#endif
